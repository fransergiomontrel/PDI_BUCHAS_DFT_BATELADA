-- WARNING: Do NOT edit the input and output ports in this file in a text
-- editor if you plan to continue editing the block that represents it in
-- the Block Editor! File corruption is VERY likely to occur.

-- Copyright (C) 2025  Altera Corporation. All rights reserved.
-- Your use of Altera Corporation's design tools, logic functions 
-- and other software and tools, and any partner logic 
-- functions, and any output files from any of the foregoing 
-- (including device programming or simulation files), and any 
-- associated documentation or information are expressly subject 
-- to the terms and conditions of the Altera Program License 
-- Subscription Agreement, the Altera Quartus Prime License Agreement,
-- the Altera IP License Agreement, or other applicable license
-- agreement, including, without limitation, that your use is for
-- the sole purpose of programming logic devices manufactured by
-- Altera and sold by Altera or its authorized distributors.  Please
-- refer to the Altera Software License Subscription Agreements 
-- on the Quartus Prime software download page.


-- Generated by Quartus Prime Version 24.1 (Build Build 1077 03/04/2025)
-- Created on Tue Aug 18 09:41:19 2026

FUNCTION acquisition_serializer_v2 (sreset, clk, serialize, msb, channel[2..0], adc_sdi[5..0])
	WITH (little_endian, bits_div_freq)
	RETURNS (data[7..0], serialize_ok, adc_sclk, test_cont[4..0], test_shift_signal, test_data[15..0], test_div_clock[(bits_div_freq) - (1)..0], test_running);
