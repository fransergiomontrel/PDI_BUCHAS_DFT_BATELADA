-- WARNING: Do NOT edit the input and output ports in this file in a text
-- editor if you plan to continue editing the block that represents it in
-- the Block Editor! File corruption is VERY likely to occur.

-- Copyright (C) 2020  Intel Corporation. All rights reserved.
-- Your use of Intel Corporation's design tools, logic functions 
-- and other software and tools, and any partner logic 
-- functions, and any output files from any of the foregoing 
-- (including device programming or simulation files), and any 
-- associated documentation or information are expressly subject 
-- to the terms and conditions of the Intel Program License 
-- Subscription Agreement, the Intel Quartus Prime License Agreement,
-- the Intel FPGA IP License Agreement, or other applicable license
-- agreement, including, without limitation, that your use is for
-- the sole purpose of programming logic devices manufactured by
-- Intel and sold by Intel or its authorized distributors.  Please
-- refer to the applicable agreement for further details, at
-- https://fpgasoftware.intel.com/eula.


-- Generated by Quartus Prime Version 20.1 (Build Build 720 11/11/2020)
-- Created on Wed Apr 07 17:55:49 2021

FUNCTION sensor_buchas_CPLD (clk, host_mode[1..0], adc_sdi[5..0], adc_rvs[5..0], host_rst_n, host_convst_start, host_MOSI, host_SCLK, host_SS_n, rst)
	RETURNS (test_addr_clr, test_addr_inc, test_sm_state[2..0], ram_we_n, ram_cs_n, ram_oe_n, test_running, adc_sdo[5..0], adc_sclk[5..0], adc_convst[5..0], adc_rst_n[5..0], test_AM_start, test_AM_adc_sclk, test_AM_adc_convst, host_MISO, host_busy, ram_address[18..0], data_bus[7..0]);
